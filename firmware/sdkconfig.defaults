## firmware/sdkconfig.defaults
```kconfig
CONFIG_IDF_TARGET="esp32c6"
CONFIG_ESPTOOLPY_FLASHMODE_QIO=y
CONFIG_ESPTOOLPY_FLASHSIZE_8MB=y
CONFIG_PARTITION_TABLE_CUSTOM=y
CONFIG_PARTITION_TABLE_CUSTOM_FILENAME="partitions.csv"
CONFIG_COMPILER_OPTIMIZATION_PERF=y
CONFIG_ESP_MAIN_TASK_STACK_SIZE=6144
CONFIG_FREERTOS_HZ=1000
CONFIG_ESP_TASK_WDT_TIMEOUT_S=5
CONFIG_ESP_TASK_WDT_EN=y
# Expose the ESP32-C6 native USB Serial/JTAG so that after the first flash
# (which needs the BOOT+RESET button sequence because the board's CH343 DTR/RTS
# aren't wired to BOOT/EN), future flashes can use `idf.py flash --before=usb-reset`
# via the native USB-CDC port (separate from /dev/ttyACM0 which is the CH343).
CONFIG_ESP_CONSOLE_USB_SERIAL_JTAG=y
CONFIG_ESP_CONSOLE_USB_SERIAL_JTAG_ENABLED=y
```
